## nuggets/feature_elixir/package/alloy_elixir/Config.in
```kconfig
config BR2_PACKAGE_HOST_ALLOY_ELIXIR
	bool "host alloy_elixir"
	depends on BR2_PACKAGE_ALLOY_ERLANG
	help
	  Host Elixir tooling (mix, elixir, iex) used by SDK project builds.

config BR2_PACKAGE_ALLOY_ELIXIR
	bool "alloy_elixir"
	depends on BR2_PACKAGE_ALLOY_ERLANG
	depends on BR2_PACKAGE_HOST_ALLOY_ELIXIR
	help
	  Alloy-managed Elixir package layered on top of alloy_erlang.

if BR2_PACKAGE_ALLOY_ELIXIR

config BR2_PACKAGE_ALLOY_ELIXIR_GLOBAL_RUNTIME
	bool "install target Elixir runtime globally in rootfs"
	default n
	depends on BR2_PACKAGE_ALLOY_ERLANG_GLOBAL_RUNTIME
	help
	  When enabled, target Elixir runtime files are installed in rootfs.
	  When disabled, Elixir host tooling remains available for project builds,
	  but the target Elixir runtime is not globally installed in rootfs.

endif
```

## nuggets/feature_erlang/package/alloy_erlang/Config.in
```kconfig
config BR2_PACKAGE_HOST_ALLOY_ERLANG_ARCH_SUPPORTS
	bool
	default y if BR2_HOSTARCH = "aarch64"
	default y if BR2_HOSTARCH = "x86_64"
	default y if BR2_HOSTARCH = "x86"

config BR2_PACKAGE_ALLOY_ERLANG_ARCH_SUPPORTS
	bool
	default y if BR2_i386 || BR2_x86_64 || BR2_powerpc || \
		BR2_sparc_v9 || BR2_arm || BR2_aarch64 || BR2_mipsel || \
		BR2_RISCV_64
	depends on BR2_PACKAGE_HOST_ALLOY_ERLANG_ARCH_SUPPORTS

comment "alloy_erlang needs a glibc or musl toolchain w/ dynamic library, threads, wchar"
	depends on BR2_USE_MMU
	depends on BR2_PACKAGE_ALLOY_ERLANG_ARCH_SUPPORTS
	depends on BR2_STATIC_LIBS || !BR2_TOOLCHAIN_HAS_THREADS || !BR2_USE_WCHAR || BR2_TOOLCHAIN_USES_UCLIBC

config BR2_PACKAGE_ALLOY_ERLANG
	bool "alloy_erlang"
	depends on BR2_USE_MMU
	depends on BR2_USE_WCHAR
	depends on !BR2_STATIC_LIBS
	depends on BR2_TOOLCHAIN_HAS_THREADS
	depends on !BR2_TOOLCHAIN_USES_UCLIBC
	depends on BR2_PACKAGE_ALLOY_ERLANG_ARCH_SUPPORTS
	select BR2_PACKAGE_ZLIB
	help
	  Alloy-managed Erlang/OTP package that installs host and target runtime
	  components for SDK project-build workflows.

if BR2_PACKAGE_ALLOY_ERLANG

config BR2_PACKAGE_ALLOY_ERLANG_GLOBAL_RUNTIME
	bool "install target Erlang runtime globally in rootfs"
	default n
	help
	  When enabled, target Erlang runtime files are installed in rootfs.
	  When disabled, target Erlang runtime remains available in staging for
	  project builds, but is not globally installed in rootfs.

config BR2_PACKAGE_ALLOY_ERLANG_XCOMP_CLOCK_GETTIME_CPU_TIME
	bool "force erl_xcomp_clock_gettime_cpu_time=yes for cross builds"
	default y
	help
	  When enabled, force Erlang configure to assume target support for
	  CLOCK_THREAD_CPUTIME_ID in cross builds.

config BR2_PACKAGE_ALLOY_ERLANG_POSIX_FALLOCATE_WORKS
	bool "force i_cv_posix_fallocate_works=yes for cross builds"
	default y
	help
	  When enabled, force Erlang configure to assume working
	  posix_fallocate() in cross builds.

endif
```

## nuggets/feature_erlang/package/alloy_rebar3/Config.in
```kconfig
config BR2_PACKAGE_HOST_ALLOY_REBAR3
	bool "host alloy_rebar3"
	depends on BR2_PACKAGE_ALLOY_ERLANG
	help
	  Rebar3 build tool for host, used to build Erlang releases.
```

## ramfs_common/Config.in
```kconfig
# Configure GRiSP ramfs builds.

config GRISP_TOP_DIR
	string
	option env="GRISP_TOP_DIR"

config GRISP_RAMFS_COMMON_DIR
	string
	option env="GRISP_RAMFS_COMMON_DIR"

config GRISP_RAMFS_FLAVOUR_DIR
	string
	option env="GRISP_RAMFS_FLAVOUR_DIR"

config GRISP_RAMFS_FLAVOUR
	string
	option env="GRISP_RAMFS_FLAVOUR"

source "$GRISP_RAMFS_FLAVOUR_DIR/Config.in"
```

## ramfs_common/defconfig
```kconfig
BR2_CCACHE=y
BR2_CCACHE_DIR="${GRISP_TOP_DIR}/_cache/buildroot-ccache"
BR2_INIT_NONE=y
BR2_ROOTFS_DEVICE_CREATION_DYNAMIC_MDEV=y
BR2_REPRODUCIBLE=y
BR2_PACKAGE_BUSYBOX=y
BR2_TARGET_ROOTFS_CPIO=y
BR2_TARGET_ROOTFS_CPIO_FULL=y
BR2_TARGET_ROOTFS_CPIO_GZIP=y
# BR2_TARGET_ROOTFS_TAR is not set
```

## ramfs_kontron-albl-imx8mm-shell/defconfig
```kconfig
BR2_aarch64=y
BR2_cortex_a53=y
BR2_ARM_FPU_VFPV3=y
BR2_TAR_OPTIONS="--no-same-owner"

BR2_TOOLCHAIN_EXTERNAL=y
BR2_TOOLCHAIN_EXTERNAL_CUSTOM=y
BR2_TOOLCHAIN_EXTERNAL_DOWNLOAD=y
BR2_TOOLCHAIN_EXTERNAL_URL="file://${GRISP_TOP_DIR}/artefacts/grisp_toolchain_aarch64_unknown_linux_gnu-1.1.linux-${GRISP_BUILD_HOST_ARCH}.tar.xz"
BR2_TOOLCHAIN_EXTERNAL_CUSTOM_PREFIX="aarch64-unknown-linux-gnu"
BR2_TOOLCHAIN_EXTERNAL_HEADERS_6_1=y
BR2_TOOLCHAIN_EXTERNAL_GCC_13=y
BR2_TOOLCHAIN_EXTERNAL_CUSTOM_GLIBC=y
BR2_TOOLCHAIN_EXTERNAL_CXX=y
BR2_TOOLCHAIN_EXTERNAL_FORTRAN=y
BR2_TOOLCHAIN_EXTERNAL_OPENMP=y
BR2_TOOLCHAIN_EXTERNAL_INET_RPC=n

BR2_ROOTFS_OVERLAY="${GRISP_RAMFS_FLAVOUR_DIR}/overlay"
```
