## system_kontron-albl-imx8mm/linux/linux-v6.12-ktn.defconfig
```kconfig
# devel
CONFIG_DEBUG_FS=y
CONFIG_DYNAMIC_DEBUG=y
CONFIG_KALLSYMS_ALL=y
CONFIG_THERMAL_EMULATION=y

# debug
#CONFIG_PM_DEBUG=y
#CONFIG_PM_TEST_SUSPEND=y
#CONFIG_PROVE_LOCKING=y
#CONFIG_DEBUG_PREEMPT=y
#CONFIG_DEBUG_RT_MUTEXES=y
#CONFIG_RT_PUSH_IPI=y
#CONFIG_PREEMPT_TRACER=y
#CONFIG_IRQSOFF_TRACER=y
#CONFIG_SCHED_TRACER=y
#CONFIG_TRACING=y
#CONFIG_FTRACE=y
#CONFIG_FUNCTION_TRACER=y
#CONFIG_WAKEUP_LATENCY_HIST=y
#CONFIG_MISSED_TIMER_OFFSETS_HIST=y
#CONFIG_HWLAT_TRACER=y
#CONFIG_OSNOISE_TRACER=y
#CONFIG_TIMERLAT_TRACER=y

# base
CONFIG_LOCALVERSION="-ktn-rt"
CONFIG_SYSVIPC=y
CONFIG_NO_HZ_FULL=y
CONFIG_HIGH_RES_TIMERS=y
CONFIG_PREEMPT_RT=y
CONFIG_IRQ_TIME_ACCOUNTING=y
CONFIG_BSD_PROCESS_ACCT=y
CONFIG_BSD_PROCESS_ACCT_V3=y
CONFIG_IKCONFIG=y
CONFIG_IKCONFIG_PROC=y
CONFIG_LOG_BUF_SHIFT=18
CONFIG_MEMCG=y
CONFIG_BLK_CGROUP=y
CONFIG_CGROUP_PIDS=y
CONFIG_CGROUP_DEVICE=y
CONFIG_CGROUP_CPUACCT=y
CONFIG_CGROUP_PERF=y
CONFIG_NAMESPACES=y
CONFIG_USER_NS=y
CONFIG_SCHED_AUTOGROUP=y
CONFIG_RELAY=y
CONFIG_BOOT_CONFIG=y
CONFIG_EXPERT=y
CONFIG_PROFILING=y
CONFIG_DRM=y
CONFIG_RT_GROUP_SCHED=y

# Essential
CONFIG_KEXEC=y
CONFIG_CPU_FREQ=y
CONFIG_CPU_FREQ_STAT=y
CONFIG_CPU_FREQ_DEFAULT_GOV_PERFORMANCE=y
CONFIG_CPU_FREQ_GOV_ONDEMAND=y
CONFIG_CPU_FREQ_GOV_POWERSAVE=y
CONFIG_CPU_FREQ_GOV_USERSPACE=y
CONFIG_CPU_FREQ_GOV_CONSERVATIVE=y
CONFIG_CPUFREQ_DT=y
CONFIG_CPU_IDLE=y
CONFIG_HIBERNATION=y
CONFIG_WQ_POWER_EFFICIENT_DEFAULT=y
CONFIG_JUMP_LABEL=y
CONFIG_MODULES=y
CONFIG_MODULE_UNLOAD=y
CONFIG_MODVERSIONS=y
CONFIG_MODULE_SRCVERSION_ALL=y
CONFIG_BINFMT_MISC=m
CONFIG_KSM=y
CONFIG_DEVTMPFS=y
CONFIG_DEVTMPFS_MOUNT=y
CONFIG_BLK_DEV_LOOP=y
CONFIG_BLK_DEV_RAM=y
CONFIG_BLK_DEV_RAM_SIZE=65536
CONFIG_LEGACY_PTY_COUNT=16
CONFIG_WATCHDOG=y
CONFIG_DMADEVICES=y
CONFIG_HWSPINLOCK=y
CONFIG_MEMORY=y
CONFIG_TEE=y
CONFIG_OPTEE=y
CONFIG_CONFIGFS_FS=y
CONFIG_SECURITY=y
CONFIG_CRYPTO_ECDH=y
CONFIG_CRC_T10DIF=y
CONFIG_PRINTK_TIME=y
CONFIG_MAGIC_SYSRQ=y
CONFIG_MEMTEST=y

# common-subsystems
CONFIG_CAN=y
CONFIG_CPU_THERMAL=y
CONFIG_GPIO_SYSFS=y
CONFIG_GPIOLIB=y
CONFIG_I2C_CHARDEV=y
CONFIG_IIO=y
CONFIG_MD=y
CONFIG_MMC=y
CONFIG_PCI=y
CONFIG_PM_DEVFREQ=y
CONFIG_PWM=y
CONFIG_RC_CORE=m
CONFIG_REGULATOR=y
CONFIG_RFKILL=m
CONFIG_RTC_CLASS=y
CONFIG_SND_SOC=y
CONFIG_SPI_SPIDEV=m
CONFIG_SPI=y
CONFIG_SPMI=y
CONFIG_SRAM=y

# bluetooth
CONFIG_BT_HCIBTUSB=m
CONFIG_BT_HCIUART_BCM=y
CONFIG_BT_HCIUART_LL=y
CONFIG_BT_HCIUART=m
CONFIG_BT_HIDP=m
CONFIG_BT_LEDS=y
CONFIG_BT=m

# usb-video
CONFIG_USB_VIDEO_CLASS=m

# tpm
CONFIG_TCG_TPM=m
CONFIG_TCG_TIS=m
CONFIG_TCG_TIS_SPI=m
CONFIG_TCG_TIS_I2C=m
CONFIG_TCG_TIS_I2C_INFINEON=m

# crypto
CONFIG_CRYPTO_AES_ARM64_BS=m
CONFIG_CRYPTO_AES_ARM64_CE_CCM=y
CONFIG_CRYPTO_ANSI_CPRNG=y
CONFIG_CRYPTO_CRCT10DIF_ARM64_CE=m
CONFIG_CRYPTO_DES=m
CONFIG_CRYPTO_DEV_FSL_CAAM=y
CONFIG_CRYPTO_ECHAINIV=y
CONFIG_CRYPTO_GHASH_ARM64_CE=y
CONFIG_CRYPTO_MD5=m
CONFIG_CRYPTO_SHA1_ARM64_CE=y
CONFIG_CRYPTO_SHA2_ARM64_CE=y
CONFIG_CRYPTO_SHA3_ARM64=m
CONFIG_CRYPTO_SHA512_ARM64_CE=m
CONFIG_CRYPTO_SM3_ARM64_CE=m

# usbnet
CONFIG_USB_LAN78XX=m
CONFIG_USB_NET_CDC_EEM=m
CONFIG_USB_NET_DM9601=m
CONFIG_USB_NET_MCS7830=m
CONFIG_USB_NET_PLUSB=m
CONFIG_USB_NET_SMSC75XX=m
CONFIG_USB_NET_SMSC95XX=m
CONFIG_USB_NET_SR9800=m
CONFIG_USB_PEGASUS=m
CONFIG_USB_RTL8150=m
CONFIG_USB_RTL8152=m
CONFIG_USB_USBNET=m

# firewall
CONFIG_IP_NF_RAW=m
CONFIG_IP_NF_SECURITY=m
CONFIG_IP_SET=m
CONFIG_IP6_NF_IPTABLES=m
CONFIG_IP6_NF_MATCH_RPFILTER=m
CONFIG_IP6_NF_RAW=m
CONFIG_IP6_NF_SECURITY=m
CONFIG_IP6_NF_TARGET_REJECT=m
CONFIG_NETFILTER_XT_MARK=m
CONFIG_NETFILTER_XT_MATCH_ADDRTYPE=m
CONFIG_NETFILTER_XT_MATCH_BPF=m
CONFIG_NETFILTER_XT_MATCH_CONNTRACK=m
CONFIG_NETFILTER_XT_MATCH_MULTIPORT=m
CONFIG_NETFILTER_XT_MATCH_STATE=m
CONFIG_NETFILTER_XT_MATCH_TCPMSS=m
CONFIG_NETFILTER_XT_SET=m
CONFIG_NETFILTER_XT_TARGET_CHECKSUM=m
CONFIG_NETFILTER_XT_TARGET_TCPMSS=m
CONFIG_NETFILTER_XT_TARGET_TCPOPTSTRIP=m
CONFIG_NF_CONNTRACK_BRIDGE=m
CONFIG_NF_CONNTRACK_MARK=y
CONFIG_NF_CONNTRACK_PROCFS=y
CONFIG_NF_CONNTRACK_ZONES=y
CONFIG_NF_CONNTRACK_NETBIOS_NS=m
CONFIG_NF_CONNTRACK=m
CONFIG_NF_CT_NETLINK=m
CONFIG_NF_TABLES_INET=y
CONFIG_NF_TABLES_NETDEV=y
CONFIG_NF_TABLES=m
CONFIG_NFT_COMPAT=m
CONFIG_NFT_CONNLIMIT=m
CONFIG_NFT_CT=m
CONFIG_NFT_FIB_INET=m
CONFIG_NFT_FIB_IPV4=m
CONFIG_NFT_FIB_IPV6=m
CONFIG_NFT_HASH=m
CONFIG_NFT_LIMIT=m
CONFIG_NFT_LOG=m
CONFIG_NFT_MASQ=m
CONFIG_NFT_NAT=m
CONFIG_NFT_NUMGEN=m
CONFIG_NFT_OSF=m
CONFIG_NFT_QUOTA=m
CONFIG_NFT_REDIR=m
CONFIG_NFT_REJECT=m
CONFIG_NFT_SOCKET=m
CONFIG_NFT_SYNPROXY=m
CONFIG_NFT_TPROXY=m
CONFIG_NFT_TUNNEL=m

# mtd
CONFIG_MTD_BLOCK=y
CONFIG_MTD_CFI_AMDSTD=y
CONFIG_MTD_CFI_INTELEXT=y
CONFIG_MTD_CFI_STAA=y
CONFIG_MTD_CFI=y
CONFIG_MTD_CMDLINE_PARTS=y
CONFIG_MTD_DATAFLASH=y
CONFIG_MTD_JEDECPROBE=y
CONFIG_MTD_MCHP48L640=y
CONFIG_MTD_RAW_NAND=y
CONFIG_MTD_SPI_NAND=y
CONFIG_MTD_SPI_NOR=y
CONFIG_MTD_SST25L=y
CONFIG_MTD_UBI_BLOCK=y
CONFIG_MTD_UBI_FASTMAP=y
CONFIG_MTD_UBI=y
CONFIG_MTD=y

# usb
CONFIG_USB_EHCI_HCD=y
CONFIG_USB_HUB_USB251XB=y
CONFIG_USB_OHCI_HCD_PCI=m
CONFIG_USB_OHCI_HCD=y
CONFIG_USB_OTG_FSM=y
CONFIG_USB_OTG=y
# CONFIG_USB_STORAGE=y              # Requires SCSI subsystem (disabled for minimal RT)
CONFIG_USB_ULPI=y
CONFIG_USB_XHCI_HCD=y
CONFIG_USB=y

# graphics
CONFIG_FB=y
CONFIG_LOGO=y
# CONFIG_LOGO_LINUX_MONO is not set
# CONFIG_LOGO_LINUX_VGA16 is not set
# CONFIG_BACKLIGHT_PWM=y
CONFIG_DRM_DISPLAY_CONNECTOR=y
CONFIG_DRM_I2C_ADV7511=y
CONFIG_DRM_LONTIUM_LT8912B=y
CONFIG_DRM_TI_SN65DSI83=y

# mmc
CONFIG_MMC_BLOCK_MINORS=32
CONFIG_MMC_SDHCI=y
CONFIG_MMC_SPI=y

# leds
CONFIG_LEDS_CLASS=y
CONFIG_LEDS_GPIO=y
CONFIG_LEDS_PWM=y
CONFIG_LEDS_SYSCON=y
CONFIG_LEDS_TRIGGER_BACKLIGHT=y
CONFIG_LEDS_TRIGGER_DEFAULT_ON=y
CONFIG_LEDS_TRIGGER_GPIO=y
CONFIG_LEDS_TRIGGER_HEARTBEAT=y
CONFIG_LEDS_TRIGGER_ONESHOT=y
CONFIG_LEDS_TRIGGER_PANIC=y
CONFIG_LEDS_TRIGGER_TIMER=y
CONFIG_NEW_LEDS=y

# sound
CONFIG_SND_AUDIO_GRAPH_CARD=m
CONFIG_SND_DYNAMIC_MINORS=y
CONFIG_SND_SIMPLE_CARD=m
CONFIG_SND_SOC_SGTL5000=m
CONFIG_SND_SOC_TLV320AIC31XX=m
CONFIG_SND_SOC_TLV320AIC32X4_I2C=m
CONFIG_SND_SOC_WM8510=m
CONFIG_SND_SOC_WM8904=m
CONFIG_SND_SOC_WM8960=m
CONFIG_SND_USB_AUDIO=m
CONFIG_SND=y
CONFIG_SOUND=y


# mx8m
CONFIG_ARCH_MXC=y
CONFIG_ARCH_NXP=y
CONFIG_ARM_IMX_BUS_DEVFREQ=y
CONFIG_ARM_IMX_CPUFREQ_DT=y
CONFIG_ARM_IMX8M_DDRC_DEVFREQ=y
CONFIG_CAN_FLEXCAN=y
CONFIG_CLK_IMX8MM=y
CONFIG_CLK_IMX8MP=y
CONFIG_CMA_SIZE_MBYTES=320
CONFIG_DRM_ETNAVIV=y
CONFIG_DRM_FSL_LDB=y
CONFIG_DRM_IMX_LCDIF=y
CONFIG_DRM_IMX8MP_DW_HDMI_BRIDGE=y
CONFIG_DRM_MXSFB=y
CONFIG_DRM_SAMSUNG_DSIM=y
CONFIG_FEC=y
CONFIG_FSL_EDMA=y
CONFIG_GPIO_MXC=y
CONFIG_I2C_IMX=y
CONFIG_IMX_SDMA=m
CONFIG_IMX2_WDT=y
CONFIG_IMX8MM_THERMAL=y
CONFIG_INTERCONNECT_IMX=y
CONFIG_INTERCONNECT_IMX8MM=y
CONFIG_INTERCONNECT_IMX8MP=y
CONFIG_INTERCONNECT=y
CONFIG_KEYBOARD_SNVS_PWRKEY=y
CONFIG_MMC_SDHCI_ESDHC_IMX=y
CONFIG_MMC_SDHCI_PLTFM=y
CONFIG_NVMEM_IMX_OCOTP=y
CONFIG_NVMEM_SNVS_LPGPR=y
CONFIG_PHY_FSL_IMX8M_PCIE=y
CONFIG_PINCTRL_IMX8MM=y
CONFIG_PINCTRL_IMX8MP=y
CONFIG_PINCTRL_SINGLE=y
CONFIG_PINCTRL=y
CONFIG_PWM_IMX27=y
CONFIG_RESET_IMX7=y
CONFIG_SERIAL_DEV_BUS=y
CONFIG_SERIAL_IMX_CONSOLE=y
CONFIG_SERIAL_IMX=y
CONFIG_SND_IMX_SOC=y
CONFIG_SND_SOC_FSL_MICFIL=m
CONFIG_SND_SOC_FSL_SAI=y
CONFIG_SPI_IMX=y
CONFIG_SPI_NXP_FLEXSPI=y
CONFIG_STAGING_MEDIA=y
CONFIG_STAGING=y
CONFIG_SYSCON_REBOOT_MODE=y
CONFIG_USB_CHIPIDEA_HOST=y
CONFIG_USB_CHIPIDEA_UDC=y
CONFIG_USB_CHIPIDEA=y
CONFIG_USB_DWC3=y
CONFIG_VIDEO_IMX_MIPI_CSIS=m

# dm
CONFIG_BLK_DEV_DM=y
CONFIG_DM_CRYPT=y
CONFIG_DM_VERITY=y

# common-drivers
CONFIG_ATH10K_PCI=m
CONFIG_ATH10K=m
# CONFIG_BACKLIGHT_CLASS_DEVICE=y
# CONFIG_BACKLIGHT_GPIO=y
# CONFIG_BACKLIGHT_LED=y
CONFIG_BLK_DEV_NBD=y
CONFIG_BLK_DEV_NVME=y
CONFIG_BRCMFMAC=m
CONFIG_CAN_MCP251X=y
CONFIG_CAN_MCP251XFD=y
CONFIG_CFG80211_WEXT=y
CONFIG_CFG80211=m
CONFIG_COMMON_CLK_PWM=y
CONFIG_DA9062_THERMAL=y
CONFIG_E1000E=y
CONFIG_EEPROM_AT24=m
CONFIG_EEPROM_AT25=m
CONFIG_EXTCON_USB_GPIO=y
CONFIG_GPIO_PCA953X_IRQ=y
CONFIG_GPIO_PCA953X=y
CONFIG_GPIO_STMPE=y
CONFIG_HID_MULTITOUCH=y
CONFIG_HOTPLUG_PCI=y
CONFIG_HW_RANDOM_ARM_SMCCC_TRNG=m
CONFIG_HW_RANDOM_CN10K=m
CONFIG_I2C_DESIGNWARE_CORE=y
CONFIG_HW_RANDOM_OPTEE=m
CONFIG_I2C_GPIO=m
CONFIG_I2C_HID_OF_GOODIX=y
CONFIG_I2C_MUX_PCA954x=y
CONFIG_I2C_MUX=y
CONFIG_I2C_RK3X=y
CONFIG_IGB=y
CONFIG_IGBVF=y
CONFIG_INPUT_EVDEV=y
CONFIG_INPUT_MISC=y
CONFIG_INPUT_MMA8450=y
CONFIG_INPUT_PWM_BEEPER=y
CONFIG_INPUT_TOUCHSCREEN=y
CONFIG_KEYBOARD_ADC=m
CONFIG_KEYBOARD_GPIO=y
CONFIG_LCD_CLASS_DEVICE=y
CONFIG_LCD_L4F00242T03=y
CONFIG_LCD_PLATFORM=y
CONFIG_MAC80211_LEDS=y
CONFIG_MAC80211=m
CONFIG_MARVELL_10G_PHY=m
CONFIG_MARVELL_PHY=m
CONFIG_MDIO_BITBANG=y
CONFIG_MDIO_BUS_MUX_MMIOREG=y
CONFIG_MFD_DA9052_I2C=y
CONFIG_MFD_DA9062=y
CONFIG_MFD_DA9063=y
CONFIG_MFD_MC13XXX_I2C=y
CONFIG_MFD_MC13XXX_SPI=y
CONFIG_MFD_STMPE=y
CONFIG_MICREL_PHY=y
CONFIG_MICROSEMI_PHY=y
CONFIG_MOUSE_PS2_ELANTECH=y
CONFIG_MOUSE_PS2=m
CONFIG_MPL3115=y
CONFIG_MWIFIEX_PCIE=m
CONFIG_MWIFIEX_SDIO=m
CONFIG_MWIFIEX_USB=m
CONFIG_MWIFIEX=m
CONFIG_NOP_USB_XCEIV=y
CONFIG_PCI_HISI=y
CONFIG_PCI_HOST_GENERIC=y
CONFIG_PCI_HOST_THUNDER_ECAM=y
CONFIG_PCI_HOST_THUNDER_PEM=y
CONFIG_PCI_IOV=y
CONFIG_PCI_XGENE=y
CONFIG_PCIE_ALTERA_MSI=y
CONFIG_PCIE_ALTERA=y
CONFIG_PCIE_KIRIN=y
CONFIG_PCIEPORTBUS=y
CONFIG_POWER_RESET_SYSCON=y
CONFIG_POWER_RESET_VEXPRESS=y
CONFIG_POWER_RESET_XGENE=y
CONFIG_QCOM_EMAC=m
CONFIG_QCOM_HIDMA_MGMT=y
CONFIG_QCOM_HIDMA=y
CONFIG_RC_DECODERS=y
CONFIG_RC_DEVICES=y
CONFIG_REALTEK_PHY=m
CONFIG_REGULATOR_DA9052=y
CONFIG_REGULATOR_DA9062=y
CONFIG_REGULATOR_DA9063=y
CONFIG_REGULATOR_FIXED_VOLTAGE=y
CONFIG_REGULATOR_GPIO=y
CONFIG_REGULATOR_MC13783=y
CONFIG_REGULATOR_MC13892=y
CONFIG_REGULATOR_PCA9450=y
CONFIG_REGULATOR_PFUZE100=y
CONFIG_REGULATOR_PWM=y
CONFIG_REGULATOR_VCTRL=m
CONFIG_ROCKCHIP_PHY=y
CONFIG_RT2800USB_RT53XX=y
CONFIG_RT2800USB=m
CONFIG_RT2X00=m
CONFIG_RTC_DRV_DS1307=y
CONFIG_RTC_DRV_DS3232=y
CONFIG_RTC_DRV_EFI=y
CONFIG_RTC_DRV_ISL1208=y
CONFIG_RTC_DRV_M41T80=y
CONFIG_RTC_DRV_MC13XXX=y
CONFIG_RTC_DRV_PCF8523=y
CONFIG_RTC_DRV_PCF8563=y
CONFIG_RTC_DRV_PL031=y
CONFIG_RTC_DRV_RV3028=y
CONFIG_RTC_DRV_RV8803=y
CONFIG_RTC_DRV_RX8581=y
CONFIG_RTC_DRV_SNVS=y
CONFIG_SENSORS_GPIO_FAN=y
CONFIG_SENSORS_IIO_HWMON=y
CONFIG_SENSORS_INA2XX=m
CONFIG_SENSORS_LM90=m
CONFIG_SENSORS_PWM_FAN=m
CONFIG_SERIO_SERPORT=m
CONFIG_SMC91X=y
CONFIG_SMSC911X=y
CONFIG_STMMAC_ETH=m
CONFIG_TOUCHSCREEN_ATMEL_MXT=m
CONFIG_TOUCHSCREEN_EDT_FT5X06=m
CONFIG_TOUCHSCREEN_EGALAX=m
CONFIG_TOUCHSCREEN_GOODIX=m
CONFIG_TOUCHSCREEN_IMX6UL_TSC=m
CONFIG_TOUCHSCREEN_SIS_I2C=m
CONFIG_TOUCHSCREEN_ST1232=m
CONFIG_USB_CONN_GPIO=y
CONFIG_USB_ONBOARD_DEV=y
CONFIG_VCNL4000=m
CONFIG_VEXPRESS_CONFIG=y
CONFIG_VFIO_PCI=y
CONFIG_VFIO=y
CONFIG_VIDEO_IMX219=m
CONFIG_WL12XX=m
CONFIG_WL18XX=m
CONFIG_WLCORE_SDIO=m

# net
# CONFIG_AUDIT is not set
CONFIG_BPF_JIT=y
CONFIG_BRIDGE_VLAN_FILTERING=y
CONFIG_BRIDGE=m
CONFIG_CONNECTOR=y
CONFIG_IP_MULTICAST=y
CONFIG_IP_NF_FILTER=m
CONFIG_IP_NF_IPTABLES=m
CONFIG_IP_NF_MANGLE=m
CONFIG_IP_NF_NAT=m
CONFIG_IP_NF_TARGET_MASQUERADE=m
CONFIG_IP_NF_TARGET_REJECT=m
CONFIG_IP_PNP_BOOTP=y
CONFIG_IP_PNP_DHCP=y
CONFIG_IP_PNP=y
CONFIG_IP6_NF_FILTER=m
CONFIG_IP6_NF_MANGLE=m
CONFIG_IP6_NF_NAT=m
CONFIG_IP6_NF_TARGET_MASQUERADE=m
CONFIG_IPV6=m
CONFIG_MACVLAN=m
CONFIG_MACVTAP=m
CONFIG_NET_9P=y
CONFIG_NET=y
CONFIG_NETDEVICES=y
CONFIG_NETFILTER_XT_TARGET_LOG=m
CONFIG_NETFILTER=y
CONFIG_NF_CONNTRACK_EVENTS=y
CONFIG_PACKET=y
CONFIG_POSIX_MQUEUE=y
CONFIG_TUN=y
CONFIG_VETH=m
CONFIG_VLAN_8021Q_GVRP=y
CONFIG_VLAN_8021Q_MVRP=y
CONFIG_VLAN_8021Q=m

# usb-serial
CONFIG_USB_ACM=m
CONFIG_USB_SERIAL_CH341=m
CONFIG_USB_SERIAL_CP210X=m
CONFIG_USB_SERIAL_FTDI_SIO=m
CONFIG_USB_SERIAL_GENERIC=y
CONFIG_USB_SERIAL_OPTION=m
CONFIG_USB_SERIAL_PL2303=m
CONFIG_USB_SERIAL=m

# aarch64
CONFIG_ARM64_VA_BITS_48=y
CONFIG_CGROUP_HUGETLB=y
CONFIG_COMPAT=y
CONFIG_CPUSETS=y
CONFIG_EFI_CAPSULE_LOADER=y
CONFIG_HUGETLBFS=y
CONFIG_INDIRECT_PIO=y
CONFIG_MEMORY_FAILURE=y
CONFIG_MV_XOR_V2=y
CONFIG_NUMA=y
CONFIG_PL330_DMA=y
CONFIG_SCHED_MC=y

# media
CONFIG_MEDIA_SUBDRV_AUTOSELECT=y
CONFIG_MEDIA_SUPPORT=m
CONFIG_MEDIA_USB_SUPPORT=y

# usb-gadget
CONFIG_USB_AUDIO=m
CONFIG_USB_CONFIGFS_ACM=y
CONFIG_USB_CONFIGFS_ECM_SUBSET=y
CONFIG_USB_CONFIGFS_ECM=y
CONFIG_USB_CONFIGFS_EEM=y
CONFIG_USB_CONFIGFS_F_FS=y
CONFIG_USB_CONFIGFS_F_HID=y
CONFIG_USB_CONFIGFS_F_LB_SS=y
CONFIG_USB_CONFIGFS_F_MIDI=y
CONFIG_USB_CONFIGFS_F_PRINTER=y
CONFIG_USB_CONFIGFS_F_UAC1=y
CONFIG_USB_CONFIGFS_F_UAC2=y
CONFIG_USB_CONFIGFS_F_UVC=y
CONFIG_USB_CONFIGFS_MASS_STORAGE=y
CONFIG_USB_CONFIGFS_NCM=y
CONFIG_USB_CONFIGFS_OBEX=y
CONFIG_USB_CONFIGFS_RNDIS=y
CONFIG_USB_CONFIGFS_SERIAL=y
CONFIG_USB_CONFIGFS=m
CONFIG_USB_ETH=m
CONFIG_USB_FUNCTIONFS=m
CONFIG_USB_G_NCM=m
CONFIG_USB_G_SERIAL=m
CONFIG_USB_GADGET=y
CONFIG_USB_GADGETFS=m
CONFIG_USB_MASS_STORAGE=m

# filesystems
CONFIG_9P_FS=y
CONFIG_AUTOFS_FS=y
CONFIG_BTRFS_FS_POSIX_ACL=y
CONFIG_BTRFS_FS=m
CONFIG_CUSE=m
CONFIG_EFIVAR_FS=y
CONFIG_EXFAT_FS=y
CONFIG_EXT2_FS_POSIX_ACL=y
CONFIG_EXT2_FS_SECURITY=y
CONFIG_EXT2_FS_XATTR=y
CONFIG_EXT2_FS=y
CONFIG_EXT3_FS_POSIX_ACL=y
CONFIG_EXT3_FS_SECURITY=y
CONFIG_EXT3_FS=y
CONFIG_FANOTIFY_ACCESS_PERMISSIONS=y
CONFIG_FANOTIFY=y
CONFIG_FUSE_FS=m
CONFIG_ISO9660_FS=m
CONFIG_JOLIET=y
CONFIG_MSDOS_FS=m
CONFIG_NFS_FS=y
CONFIG_NFS_V4_1=y
CONFIG_NFS_V4_2=y
CONFIG_NFS_V4=y
CONFIG_NLS_ASCII=y
CONFIG_NLS_CODEPAGE_437=y
CONFIG_NLS_ISO8859_1=y
CONFIG_NLS_ISO8859_15=m
CONFIG_NLS_UTF8=y
CONFIG_OVERLAY_FS=m
CONFIG_QUOTA_NETLINK_INTERFACE=y
CONFIG_QUOTA=y
CONFIG_ROOT_NFS=y
CONFIG_SQUASHFS=y
CONFIG_UBIFS_FS=y
CONFIG_UDF_FS=m
CONFIG_VFAT_FS=y
CONFIG_ZISOFS=y
```
