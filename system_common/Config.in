## system_common/Config.in
```kconfig
# Configure Common Grisp

config GRISP_TOP_DIR
	string
	option env="GRISP_TOP_DIR"

config GRISP_COMMON_SYSTEM_DIR
	string
	option env="GRISP_COMMON_SYSTEM_DIR"

config GRISP_TARGET_SYSTEM_DIR
	string
	option env="GRISP_TARGET_SYSTEM_DIR"

config GRISP_TARGET_NAME
	string "Grisp target name"
	default ""

# Load Grisp packages
source "$BR2_EXTERNAL_GRISP_PATH/package/erlinit/Config.in"
source "$BR2_EXTERNAL_GRISP_PATH/package/nbtty/Config.in"
source "$BR2_EXTERNAL_GRISP_PATH/package/grisp-config/Config.in"
source "$BR2_EXTERNAL_GRISP_PATH/package/erlang-rebar3/Config.in"
source "$BR2_EXTERNAL_GRISP_PATH/package/cryptoauthlib/Config.in"
source "$BR2_EXTERNAL_GRISP_PATH/package/grisp-updater-tools/Config.in.host"

# Load user options
menu "User-provided options"

source "$GRISP_TARGET_SYSTEM_DIR/Config.in"

endmenu
```

## system_common/defconfig
```kconfig
BR2_GLOBAL_PATCH_DIR="${GRISP_COMMON_SYSTEM_DIR}/patches"
BR2_CCACHE=y
BR2_CCACHE_DIR="${GRISP_TOP_DIR}/_cache/buildroot-ccache"
BR2_INIT_NONE=y
BR2_ENABLE_LOCALE_WHITELIST="locale-archive"
BR2_GENERATE_LOCALE="en_US.UTF-8"
BR2_ROOTFS_SKELETON_CUSTOM=y
BR2_ROOTFS_SKELETON_CUSTOM_PATH="${GRISP_COMMON_SYSTEM_DIR}/board/grisp-common/skeleton"
BR2_ROOTFS_OVERLAY="${GRISP_COMMON_SYSTEM_DIR}/board/grisp-common/rootfs_overlay"
BR2_ROOTFS_POST_BUILD_SCRIPT="${GRISP_COMMON_SYSTEM_DIR}/board/grisp-common/post-build.sh"
BR2_ROOTFS_POST_IMAGE_SCRIPT="${GRISP_COMMON_SYSTEM_DIR}/board/grisp-common/post-image.sh"

BR2_REPRODUCIBLE=y

BR2_PACKAGE_BUSYBOX_CONFIG="${GRISP_COMMON_SYSTEM_DIR}/board/grisp-common/busybox.config"
BR2_PACKAGE_F2FS_TOOLS=y
BR2_PACKAGE_LIBP11=y
BR2_PACKAGE_LIBMNL=y
BR2_PACKAGE_NBTTY=y
BR2_PACKAGE_GRISP_CONFIG=y
```

## system_common/package/cryptoauthlib/Config.in
```kconfig
config BR2_PACKAGE_CRYPTOAUTHLIB
	bool "cryptoauthlib"
	help
	  https://github.com/MicrochipTech/cryptoauthlib
```

## system_common/package/elixir/Config.in
```kconfig
config BR2_PACKAGE_ELIXIR
	bool "elixir"
	depends on BR2_PACKAGE_ERLANG
	help
	  Elixir programming language and tooling (runs on the Erlang VM).

	  NOTE: GRiSP ALLoy does not deploy Elixir binaries to the target by
	  default. This package is primarily used to produce Elixir tooling
	  in the SDK (host-elixir) and to stage Elixir stdlib when needed
	  for release assembly. Target install step is intentionally empty
	  unless explicitly enabled.
```

## system_common/package/elixir/Config.in.host
```kconfig
config BR2_PACKAGE_HOST_ELIXIR
	bool "host elixir"
	help
	  Elixir tooling for the host (provides elixir and mix in the SDK).
```

## system_common/package/erlang-rebar3/Config.in
```kconfig
config BR2_PACKAGE_ERLANG_REBAR3
	bool "erlang-rebar3"
	depends on BR2_PACKAGE_ERLANG
	help
	  https://github.com/erlang/rebar3
```

## system_common/package/grisp-config/Config.in
```kconfig
menuconfig BR2_PACKAGE_GRISP_CONFIG
	bool "grisp-config"
	select BR2_PACKAGE_OPENSSL
	select BR2_PACKAGE_ERLANG
	select BR2_PACKAGE_ERLINIT
	select BR2_PACKAGE_HOST_FWUP
	select BR2_PACKAGE_FWUP
	select BR2_PACKAGE_NCURSES
	select BR2_TARGET_ROOTFS_SQUASHFS
	select BR2_PACKAGE_RNG_TOOLS
```

## system_common/package/grisp-updater-tools/Config.in.host
```kconfig
config BR2_PACKAGE_HOST_GRISP_UPDATER_TOOLS
	bool "host grisp-updater-tools"
	depends on BR2_PACKAGE_ERLANG
	help
		GRiSP Software Update Tools
```

## system_grisp2/defconfig
```kconfig
BR2_ROOTFS_OVERLAY="${GRISP_COMMON_SYSTEM_DIR}/board/grisp-common/rootfs_overlay ${GRISP_TARGET_SYSTEM_DIR}/rootfs_overlay"
BR2_ROOTFS_POST_BUILD_SCRIPT="${GRISP_COMMON_SYSTEM_DIR}/board/grisp-common/post-build.sh ${GRISP_TARGET_SYSTEM_DIR}/post-build.sh"

BR2_arm=y
BR2_cortex_a7=y
BR2_ARM_FPU_NEON_VFPV4=y
BR2_TAR_OPTIONS="--no-same-owner"

BR2_TOOLCHAIN_EXTERNAL=y
BR2_TOOLCHAIN_EXTERNAL_CUSTOM=y
BR2_TOOLCHAIN_EXTERNAL_DOWNLOAD=y
BR2_TOOLCHAIN_EXTERNAL_URL="file://${GRISP_TOP_DIR}/artefacts/grisp_toolchain_armv7_unknown_linux_gnueabihf-3.0.linux-${GRISP_BUILD_HOST_ARCH}.tar.xz"
BR2_TOOLCHAIN_EXTERNAL_CUSTOM_PREFIX="armv7-unknown-linux-gnueabihf"
BR2_TOOLCHAIN_EXTERNAL_GCC_13=y
BR2_TOOLCHAIN_EXTERNAL_HEADERS_5_4=y
BR2_TOOLCHAIN_EXTERNAL_CUSTOM_GLIBC=y
BR2_TOOLCHAIN_EXTERNAL_CXX=y
BR2_TOOLCHAIN_EXTERNAL_FORTRAN=y
BR2_TOOLCHAIN_EXTERNAL_OPENMP=y
BR2_TOOLCHAIN_EXTERNAL_INET_RPC=n

BR2_LINUX_KERNEL=y
BR2_LINUX_KERNEL_CUSTOM_TARBALL=y
BR2_LINUX_KERNEL_CUSTOM_TARBALL_LOCATION="https://git.phytec.de/linux-mainline/snapshot/linux-mainline-5.15.102-phy2.tar.bz2"
BR2_LINUX_KERNEL_PATCH="${GRISP_TARGET_SYSTEM_DIR}/linux"
BR2_LINUX_KERNEL_USE_CUSTOM_CONFIG=y
BR2_LINUX_KERNEL_CUSTOM_CONFIG_FILE="${GRISP_TARGET_SYSTEM_DIR}/linux/linux-5.15.defconfig"
BR2_LINUX_KERNEL_XZ=y
BR2_LINUX_KERNEL_DTS_SUPPORT=y
BR2_LINUX_KERNEL_CUSTOM_DTS_PATH="${GRISP_TARGET_SYSTEM_DIR}/linux/imx6ull-grisp2.dts"
BR2_LINUX_KERNEL_INSTALL_TARGET=y
BR2_LINUX_KERNEL_NEEDS_HOST_OPENSSL=y

BR2_PACKAGE_FREESCALE_IMX=y
BR2_PACKAGE_FREESCALE_IMX_PLATFORM_IMX6UL=y
BR2_PACKAGE_FIRMWARE_IMX=y
BR2_ROOTFS_DEVICE_CREATION_DYNAMIC_EUDEV=y
BR2_PACKAGE_DT_UTILS=y
BR2_PACKAGE_WIRELESS_REGDB=y
BR2_PACKAGE_WPA_SUPPLICANT=y
BR2_PACKAGE_WPA_SUPPLICANT_WEXT=y
BR2_PACKAGE_WPA_SUPPLICANT_WIRED=y
BR2_PACKAGE_WPA_SUPPLICANT_AP_SUPPORT=y
BR2_PACKAGE_WPA_SUPPLICANT_HOTSPOT=y
BR2_PACKAGE_WPA_SUPPLICANT_DEBUG_SYSLOG=y
BR2_PACKAGE_WPA_SUPPLICANT_WPA3=y
BR2_PACKAGE_WPA_SUPPLICANT_CTRL_IFACE=y

#BR2_TARGET_BAREBOX=y
#BR2_TARGET_BAREBOX_CUSTOM_GIT=y
#BR2_TARGET_BAREBOX_VERSION="gitversion"
#BR2_TARGET_BAREBOX_CUSTOM_PATCH_DIR=""
#BR2_TARGET_BAREBOX_CUSTOM_GIT_REPO_URL="http://git.of.barbox.com/git/stuff"
#BR2_TARGET_BAREBOX_CUSTOM_GIT_VERSION="gitversion"
#BR2_TARGET_BAREBOX_USE_DEFCONFIG=y
## BR2_TARGET_BAREBOX_USE_CUSTOM_CONFIG is not set
#BR2_TARGET_BAREBOX_BOARD_DEFCONFIG="some defconfig path"
#BR2_TARGET_BAREBOX_CONFIG_FRAGMENT_FILES=""
#BR2_TARGET_BAREBOX_IMAGE_FILE="image name"
## BR2_TARGET_BAREBOX_BAREBOXENV is not set
## BR2_TARGET_BAREBOX_CUSTOM_ENV is not set
#BR2_TARGET_BAREBOX_CUSTOM_EMBEDDED_ENV_PATH=""
## BR2_TARGET_BAREBOX_AUX is not set

# For debugging
BR2_PACKAGE_OPENSSH=y
BR2_TOOLCHAIN_EXTERNAL_GDB_SERVER_COPY=y
BR2_PACKAGE_STRACE=y
```

## system_kontron-albl-imx8mm/defconfig
```kconfig
BR2_GLOBAL_PATCH_DIR="$(GRISP_TARGET_SYSTEM_DIR)/patches"
BR2_ROOTFS_OVERLAY="${GRISP_COMMON_SYSTEM_DIR}/board/grisp-common/rootfs_overlay ${GRISP_TARGET_SYSTEM_DIR}/rootfs_overlay"
BR2_ROOTFS_POST_BUILD_SCRIPT="${GRISP_COMMON_SYSTEM_DIR}/board/grisp-common/post-build.sh ${GRISP_TARGET_SYSTEM_DIR}/post-build.sh"

BR2_aarch64=y
BR2_cortex_a53=y
BR2_ARM_FPU_VFPV3=y
BR2_TAR_OPTIONS="--no-same-owner"

BR2_TOOLCHAIN_EXTERNAL=y
BR2_TOOLCHAIN_EXTERNAL_CUSTOM=y
BR2_TOOLCHAIN_EXTERNAL_DOWNLOAD=y
BR2_TOOLCHAIN_EXTERNAL_URL="file://${GRISP_TOP_DIR}/artefacts/grisp_toolchain_aarch64_unknown_linux_gnu-1.1.linux-${GRISP_BUILD_HOST_ARCH}.tar.xz"
BR2_TOOLCHAIN_EXTERNAL_CUSTOM_PREFIX="aarch64-unknown-linux-gnu"
BR2_TOOLCHAIN_EXTERNAL_HEADERS_6_1=y
BR2_TOOLCHAIN_EXTERNAL_GCC_13=y
BR2_TOOLCHAIN_EXTERNAL_CUSTOM_GLIBC=y
BR2_TOOLCHAIN_EXTERNAL_CXX=y
BR2_TOOLCHAIN_EXTERNAL_FORTRAN=y
BR2_TOOLCHAIN_EXTERNAL_OPENMP=y
BR2_TOOLCHAIN_EXTERNAL_INET_RPC=n

BR2_LINUX_KERNEL=y
BR2_LINUX_KERNEL_CUSTOM_GIT=y
BR2_LINUX_KERNEL_CUSTOM_REPO_URL="https://git.kontron-electronics.de/sw/misc/linux.git"
BR2_LINUX_KERNEL_CUSTOM_REPO_VERSION="v6.12-ktn"
BR2_LINUX_KERNEL_USE_CUSTOM_CONFIG=y
BR2_LINUX_KERNEL_CUSTOM_CONFIG_FILE="${GRISP_TARGET_SYSTEM_DIR}/linux/linux-v6.12-ktn.defconfig"
BR2_LINUX_KERNEL_XZ=y
BR2_LINUX_KERNEL_DTS_SUPPORT=y
BR2_LINUX_KERNEL_INTREE_DTS_NAME="freescale/imx8mm-kontron-bl"
BR2_LINUX_KERNEL_INSTALL_TARGET=y
BR2_LINUX_KERNEL_NEEDS_HOST_OPENSSL=y

BR2_TARGET_UBOOT=y
BR2_TARGET_UBOOT_BUILD_SYSTEM_KCONFIG=y
BR2_TARGET_UBOOT_CUSTOM_GIT=y
BR2_TARGET_UBOOT_CUSTOM_REPO_URL="https://git.kontron-electronics.de/sw/misc/u-boot.git"
BR2_TARGET_UBOOT_CUSTOM_REPO_VERSION="v2024.01-ktn"
BR2_TARGET_UBOOT_BOARD_DEFCONFIG="kontron-sl-mx8mm"
BR2_TARGET_UBOOT_NEEDS_DTC=y
BR2_TARGET_UBOOT_NEEDS_PYLIBFDT=y
BR2_TARGET_UBOOT_NEEDS_OPENSSL=y
BR2_TARGET_UBOOT_NEEDS_GNUTLS=y
BR2_TARGET_UBOOT_NEEDS_UTIL_LINUX=y
BR2_TARGET_UBOOT_NEEDS_ATF_BL31=y
BR2_TARGET_UBOOT_NEEDS_IMX_FIRMWARE=y
BR2_TARGET_UBOOT_FORMAT_CUSTOM=y
BR2_TARGET_UBOOT_FORMAT_CUSTOM_NAME="flash.bin u-boot-spl.bin u-boot-spl-ddr.bin u-boot-nodtb.bin u-boot.bin"
BR2_TARGET_UBOOT_SPL=y
BR2_TARGET_UBOOT_DEFAULT_ENV_FILE="${GRISP_TARGET_SYSTEM_DIR}/uboot/uboot.env"
BR2_TARGET_UBOOT_CONFIG_FRAGMENT_FILES="${GRISP_TARGET_SYSTEM_DIR}/uboot/uboot.config"

BR2_TARGET_GENERIC_GETTY_PORT="ttymxc2"
BR2_TARGET_ARM_TRUSTED_FIRMWARE=y
BR2_TARGET_ARM_TRUSTED_FIRMWARE_CUSTOM_VERSION=y
BR2_TARGET_ARM_TRUSTED_FIRMWARE_CUSTOM_VERSION_VALUE="v2.6"
BR2_TARGET_ARM_TRUSTED_FIRMWARE_PLATFORM="imx8mm"
BR2_TARGET_ARM_TRUSTED_FIRMWARE_ADDITIONAL_VARIABLES="IMX_BOOT_UART_BASE=0x30880000"

BR2_ROOTFS_DEVICE_CREATION_DYNAMIC_EUDEV=y

BR2_PACKAGE_HOST_LINUX_HEADERS_CUSTOM_6_12=y
BR2_PACKAGE_HOST_IMX_MKIMAGE=y
BR2_PACKAGE_HOST_UBOOT_TOOLS=y
BR2_PACKAGE_HOST_UBOOT_TOOLS_FIT_SUPPORT=y
BR2_PACKAGE_HOST_UBOOT_TOOLS_FIT_SIGNATURE_SUPPORT=y
BR2_PACKAGE_HOST_UBOOT_TOOLS_FWPRINTENV=y
BR2_PACKAGE_HOST_UBOOT_TOOLS_ENVIMAGE=y
BR2_PACKAGE_HOST_UBOOT_TOOLS_ENVIMAGE_SOURCE="${GRISP_TARGET_SYSTEM_DIR}/uboot/uboot.env"
BR2_PACKAGE_HOST_UBOOT_TOOLS_ENVIMAGE_SIZE="0x10000"
BR2_PACKAGE_HOST_UBOOT_TOOLS_ENVIMAGE_REDUNDANT=y
BR2_PACKAGE_HOST_ELIXIR=y
BR2_PACKAGE_UBOOT_TOOLS=y
BR2_PACKAGE_UBOOT_TOOLS_FWPRINTENV=y
BR2_PACKAGE_FREESCALE_IMX=y
BR2_PACKAGE_FREESCALE_IMX_PLATFORM_IMX8MM=y
BR2_PACKAGE_FIRMWARE_IMX=y
BR2_PACKAGE_IMX_GPU_VIV=y
BR2_PACKAGE_CAN_UTILS=y

# For debugging
BR2_PACKAGE_OPENSSH=y
BR2_TOOLCHAIN_EXTERNAL_GDB_SERVER_COPY=y
BR2_PACKAGE_STRACE=y

# RT testing and debugging tools
BR2_PACKAGE_RT_TESTS=y
BR2_PACKAGE_STRESS_NG=y
BR2_PACKAGE_HTOP=y
BR2_PACKAGE_UTIL_LINUX_SCHEDUTILS=y
```

## system_kontron-albl-imx8mm/initramfs/kontron-albl-imx8mm-initramfs_defconfig
```kconfig
BR2_aarch64=y
BR2_ARM_FPU_VFPV3=y
BR2_TOOLCHAIN_EXTERNAL=y
BR2_TOOLCHAIN_EXTERNAL_CUSTOM=y
BR2_TOOLCHAIN_EXTERNAL_DOWNLOAD=y
BR2_TOOLCHAIN_EXTERNAL_URL="file:///home/vagrant/artefacts/grisp_toolchain_aarch64_unknown_linux_gnu-1.1.linux-aarch64.tar.xz"
BR2_TOOLCHAIN_EXTERNAL_CUSTOM_PREFIX="aarch64-unknown-linux-gnu"
BR2_TOOLCHAIN_EXTERNAL_GCC_13=y
BR2_TOOLCHAIN_EXTERNAL_HEADERS_6_1=y
BR2_TOOLCHAIN_EXTERNAL_CUSTOM_GLIBC=y
BR2_TOOLCHAIN_EXTERNAL_CXX=y
BR2_TOOLCHAIN_EXTERNAL_FORTRAN=y
BR2_TOOLCHAIN_EXTERNAL_OPENMP=y
BR2_WGET="wget --passive-ftp -nd -t 3"
BR2_SVN="svn --non-interactive"
BR2_SCP="scp"
BR2_TAR_OPTIONS="--no-same-owner"
BR2_BACKUP_SITE="http://sources.buildroot.net"
BR2_GNU_MIRROR="http://ftpmirror.gnu.org"
BR2_CPAN_MIRROR="http://cpan.metacpan.org"
BR2_OPTIMIZE_S=y
BR2_SSP_NONE=y
BR2_RELRO_NONE=y
BR2_FORTIFY_SOURCE_NONE=y
BR2_ROOTFS_DEVICE_CREATION_DYNAMIC_EUDEV=y
BR2_TARGET_GENERIC_GETTY_PORT="ttymxc2"
BR2_LINUX_KERNEL=y
BR2_LINUX_KERNEL_CUSTOM_GIT=y
BR2_LINUX_KERNEL_CUSTOM_REPO_URL="https://git.kontron-electronics.de/sw/misc/linux.git"
BR2_LINUX_KERNEL_CUSTOM_REPO_VERSION="v6.12-ktn"
BR2_LINUX_KERNEL_USE_CUSTOM_CONFIG=y
BR2_LINUX_KERNEL_CUSTOM_CONFIG_FILE="/home/vagrant/system_kontron-albl-imx8mm/linux/linux-v6.12-ktn.defconfig"
BR2_LINUX_KERNEL_XZ=y
BR2_LINUX_KERNEL_DTS_SUPPORT=y
BR2_LINUX_KERNEL_INTREE_DTS_NAME="freescale/imx8mm-kontron-bl"
BR2_LINUX_KERNEL_NEEDS_HOST_OPENSSL=y
BR2_PACKAGE_LUKSMETA=y
BR2_PACKAGE_KEYUTILS=y
BR2_PACKAGE_UTIL_LINUX_BINARIES=y
BR2_TARGET_ROOTFS_CPIO_GZIP=y
BR2_TARGET_ROOTFS_INITRAMFS=y
BR2_PACKAGE_HOST_IMX_MKIMAGE=y
BR2_PACKAGE_HOST_UBOOT_TOOLS=y
```
